/**
 * Copyright (C) 2014 Hisilicon Ltd.
 *
 *  This program is free software; you can redistribute it and/or modify
 *  it under the terms of the GNU General Public License version 2 as
 *  publishhed by the Free Software Foundation.
 */

/include/ "VOGUE_TUGL_VE2_overlay.dtsi"

/ {
    board_id = <8558>;
};
    &rootparam{
		compatible = "hisilicon,vendor";
		hisi,boardid = <8 5 5 8>;
		hisi,boardname = "VOGUE_TUGL_VF2";
		hisi,modem_id = <0x37054C00>;
		hisi,product_id = <0x37054C00>;
		hisi,product_name = "VOG-AL00";
	};

	&dwmmc1 {
		use_samdly_range = <5 8>;
		enable_shift_range = <4 8>;
		clock-frequency = <192>;
	};
