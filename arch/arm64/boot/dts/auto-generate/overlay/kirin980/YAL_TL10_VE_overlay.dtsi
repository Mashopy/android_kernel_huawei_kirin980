/**
 * Copyright (C) 2014 Hisilicon Ltd.
 *
 *  This program is free software; you can redistribute it and/or modify
 *  it under the terms of the GNU General Public License version 2 as
 *  publishhed by the Free Software Foundation.
 */

/include/ "YAL_TL00_VB_overlay.dtsi"

/ {
	board_id = <8824>;
};

	&rootparam{
		hisi,boardid = <8 8 2 4>;
		hisi,boardname = "YAL_TL10_VE";
		hisi,modem_id = <0x37634C00>;
		hisi,product_id = <0x37634C00>;
		hisi,product_name = "YAL-TL10";
	};
