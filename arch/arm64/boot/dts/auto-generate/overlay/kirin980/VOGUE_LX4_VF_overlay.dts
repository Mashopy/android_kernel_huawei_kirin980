/**
 * Copyright (C) 2014 Hisilicon Ltd.
 *
 *  This program is free software; you can redistribute it and/or modify
 *  it under the terms of the GNU General Public License version 2 as
 *  publishhed by the Free Software Foundation.
 */

/dts-v1/;
/plugin/;
/include/ "VOGUE_LX4_VE_overlay.dtsi"
/include/ "VOGUE_LX4_VF_pin.dtsi"
/include/ "VOGUE_LX4_VF_modem_pin.dtsi"

/ {
    board_id = <8560>;
};
    &rootparam{
		compatible = "hisilicon,vendor";
		hisi,boardid = <8 5 6 0>;
		hisi,boardname = "VOGUE_LX4_VF";
		hisi,modem_id = <0x3705D400>;
		hisi,product_id = <0x3705D400>;
		hisi,product_name = "VOG-LX4";
	};

	&dwmmc1 {
		use_samdly_range = <5 8>;
		enable_shift_range = <4 8>;
		clock-frequency = <192>;
	};
