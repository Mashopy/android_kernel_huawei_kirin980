/**
 * Copyright (C) 2014 Hisilicon Ltd.
 *
 *  This program is free software; you can redistribute it and/or modify
 *  it under the terms of the GNU General Public License version 2 as
 *  publishhed by the Free Software Foundation.
 */

/dts-v1/;
/plugin/;
/include/ "YAL_TL00_VE_overlay.dtsi"
/include/ "YAL_TL00_VF_pin.dtsi"
/include/ "YAL_TL00_VF_modem_pin.dtsi"

/ {
	board_id = <8809>;
};

	&rootparam{
		hisi,boardid = <8 8 0 9>;
		hisi,boardname = "YAL_TL00_VF";
		hisi,modem_id = <0x37633800>;
		hisi,product_id = <0x37633800>;
		hisi,product_name = "YAL-TL00";
	};
