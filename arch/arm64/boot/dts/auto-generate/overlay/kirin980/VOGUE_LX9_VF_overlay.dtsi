/**
 * Copyright (C) 2014 Hisilicon Ltd.
 *
 *  This program is free software; you can redistribute it and/or modify
 *  it under the terms of the GNU General Public License version 2 as
 *  publishhed by the Free Software Foundation.
 */

/include/ "VOGUE_LX9_VE_overlay.dtsi"

/ {
    board_id = <8559>;
};
    &rootparam{
		compatible = "hisilicon,vendor";
		hisi,boardid = <8 5 5 9>;
		hisi,boardname = "VOGUE_LX9_VF";
		hisi,modem_id = <0x37055000>;
		hisi,product_id = <0x37055000>;
		hisi,product_name = "VOG-LX9";
	};

	&dwmmc1 {
		use_samdly_range = <5 8>;
		enable_shift_range = <4 8>;
		clock-frequency = <192>;
	};
