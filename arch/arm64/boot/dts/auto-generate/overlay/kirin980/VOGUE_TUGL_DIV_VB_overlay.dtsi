/**
 * Copyright (C) 2014 Hisilicon Ltd.
 *
 *  This program is free software; you can redistribute it and/or modify
 *  it under the terms of the GNU General Public License version 2 as
 *  publishhed by the Free Software Foundation.
 */

/include/ "VOGUE_TUGL_DIV_VA_overlay.dtsi"

/ {
    board_id = <8556>;
};
    &rootparam{
		compatible = "hisilicon,vendor";
		hisi,boardid = <8 5 5 6>;
		hisi,boardname = "VOGUE_TUGL_DIV_VB";
		hisi,modem_id = <0x37056C00>;
		hisi,product_id = <0x37056C00>;
		hisi,product_name = "VOG-AL00";
	};
