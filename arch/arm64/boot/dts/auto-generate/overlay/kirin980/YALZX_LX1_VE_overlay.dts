/**
 * Copyright (C) 2014 Hisilicon Ltd.
 *
 *  This program is free software; you can redistribute it and/or modify
 *  it under the terms of the GNU General Public License version 2 as
 *  publishhed by the Free Software Foundation.
 */

/dts-v1/;
/plugin/;
/include/ "YALZX_LX1_VC_overlay.dtsi"
/include/ "YALZX_LX1_VE_pin.dtsi"
/include/ "YALZX_LX1_VE_modem_pin.dtsi"

/ {
	board_id = <8827>;
};

	&rootparam{
		hisi,boardid = <8 8 2 7>;
		hisi,boardname = "YALZX_LX1_VE";
		hisi,modem_id = <0x37663400>;
		hisi,product_id = <0x37663400>;
		hisi,product_name = "YALZX-LX1";
	};
