/**
 * Copyright (C) 2014 Hisilicon Ltd.
 *
 *  This program is free software; you can redistribute it and/or modify
 *  it under the terms of the GNU General Public License version 2 as
 *  publishhed by the Free Software Foundation.
 */

/dts-v1/;
/plugin/;
/include/ "YAL_LX1_VD_overlay.dtsi"
/include/ "YAL_LX1_VE_pin.dtsi"
/include/ "YAL_LX1_VE_modem_pin.dtsi"

/ {
	board_id = <8823>;
};

	&rootparam{
		hisi,boardid = <8 8 2 3>;
		hisi,boardname = "YAL_LX1_VE";
		hisi,modem_id = <0x37633000>;
		hisi,product_id = <0x37633000>;
		hisi,product_name = "YAL-LX1";
	};
