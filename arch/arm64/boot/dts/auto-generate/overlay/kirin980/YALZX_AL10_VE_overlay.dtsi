/**
 * Copyright (C) 2014 Hisilicon Ltd.
 *
 *  This program is free software; you can redistribute it and/or modify
 *  it under the terms of the GNU General Public License version 2 as
 *  publishhed by the Free Software Foundation.
 */

/include/ "YALZX_AL10_VD_overlay.dtsi"

/ {
	board_id = <8826>;
};

	&rootparam{
		hisi,boardid = <8 8 2 6>;
		hisi,boardname = "YALZX_AL10_VE";
		hisi,modem_id = <0x37663000>;
		hisi,product_id = <0x37663000>;
		hisi,product_name = "YALZX-AL10";
	};